/* Generated by scripts/neogeo_modern_sets.py from current MAME's neogeo.cpp: do not edit. */
GAME( 1990, nam1975m, nam1975, neogeo, neogeo, neogeo, ROT0, "SNK", "NAM-1975 (NGM-001 ~ NGH-001) (modern set)" )
GAME( 1990, bstarsm, bstars, neogeo, neogeo, neogeo, ROT0, "SNK", "Baseball Stars Professional (NGM-002) (modern set)" )
GAME( 1990, tpgolfm, tpgolf, neogeo, neogeo, neogeo, ROT0, "SNK", "Top Player's Golf (NGM-003 ~ NGH-003) (modern set)" )
GAME( 1990, mahretsum, mahretsu, neogeo, neogeo, neogeo, ROT0, "SNK", "Mahjong Kyo Retsuden (NGM-004 ~ NGH-004) (modern set)" )
GAME( 1990, maglordm, maglord, neogeo, neogeo, neogeo, ROT0, "Alpha Denshi Co.", "Magician Lord (NGM-005) (modern set)" )
GAME( 1991, alpham2m, alpham2, neogeo, neogeo, neogeo, ROT0, "SNK", "Alpha Mission II / ASO II - Last Guardian (NGM-007 ~ NGH-007) (modern set)" )
GAME( 1990, ncombatm, ncombat, neogeo, neogeo, neogeo, ROT0, "Alpha Denshi Co.", "Ninja Combat (NGM-009) (modern set)" )
GAME( 1990, cyberlipm, cyberlip, neogeo, neogeo, neogeo, ROT0, "SNK", "Cyber-Lip (NGM-010) (modern set)" )
GAME( 1990, superspym, superspy, neogeo, neogeo, neogeo, ROT0, "SNK", "The Super Spy (NGM-011 ~ NGH-011) (modern set)" )
GAME( 1992, mutnatm, mutnat, neogeo, neogeo, neogeo, ROT0, "SNK", "Mutation Nation (NGM-014 ~ NGH-014) (modern set)" )
GAME( 1991, kotmm, kotm, neogeo, neogeo, neogeo, ROT0, "SNK", "King of the Monsters (set 1) (modern set)" )
GAME( 1991, sengokum, sengoku, neogeo, neogeo, neogeo, ROT0, "SNK", "Sengoku / Sengoku Denshou (NGM-017 ~ NGH-017) (modern set)" )
GAME( 1991, burningfm, burningf, neogeo, neogeo, neogeo, ROT0, "SNK", "Burning Fight (NGM-018 ~ NGH-018) (modern set)" )
GAME( 1991, gpilotsm, gpilots, neogeo, neogeo, neogeo, ROT0, "SNK", "Ghost Pilots (NGM-020 ~ NGH-020) (modern set)" )
GAME( 1990, joyjoym, joyjoy, neogeo, neogeo, neogeo, ROT0, "SNK", "Puzzled / Joy Joy Kid (NGM-021 ~ NGH-021) (modern set)" )
GAME( 1990, bjourneym, bjourney, neogeo, neogeo, neogeo, ROT0, "Alpha Denshi Co.", "Blue's Journey / Raguy (ALM-001 ~ ALH-001) (modern set)" )
GAME( 1991, quizdaism, quizdais, neogeo, neogeo, neogeo, ROT0, "SNK", "Quiz Daisousa Sen - The Last Count Down (NGM-023 ~ NGH-023) (modern set)" )
GAME( 1992, lresortm, lresort, neogeo, neogeo, neogeo, ROT0, "SNK", "Last Resort (modern set)" )
GAME( 1991, eightmanm, eightman, neogeo, neogeo, neogeo, ROT0, "SNK / Pallas", "Eight Man (NGM-025 ~ NGH-025) (modern set)" )
GAME( 1991, legendosm, legendos, neogeo, neogeo, neogeo, ROT0, "SNK / Wave", "Legend of Success Joe / Ashita no Joe Densetsu (modern set)" )
GAME( 1991, 2020bbm, 2020bb, neogeo, neogeo, neogeo, ROT0, "SNK / Pallas", "2020 Super Baseball (set 1) (modern set)" )
GAME( 1991, socbrawlm, socbrawl, neogeo, neogeo, neogeo, ROT0, "SNK", "Soccer Brawl (NGM-031) (modern set)" )
GAME( 1991, roboarmym, roboarmy, neogeo, neogeo, neogeo, ROT0, "SNK", "Robo Army (modern set)" )
GAME( 1991, fatfury1m, fatfury1, neogeo, neogeo, neogeo, ROT0, "SNK", "Fatal Fury - King of Fighters / Garou Densetsu - Shukumei no Tatakai (NGM-033 ~ NGH-033) (modern set)" )
GAME( 1992, fbfrenzym, fbfrenzy, neogeo, neogeo, neogeo, ROT0, "SNK", "Football Frenzy (NGM-034 ~ NGH-034) (modern set)" )
GAME( 1991, crswordm, crsword, neogeo, neogeo, neogeo, ROT0, "Alpha Denshi Co.", "Crossed Swords (ALM-002 ~ ALH-002) (modern set)" )
GAME( 1992, bstars2m, bstars2, neogeo, neogeo, neogeo, ROT0, "SNK", "Baseball Stars 2 (modern set)" )
GAME( 1992, quizdai2m, quizdai2, neogeo, neogeo, neogeo, ROT0, "SNK", "Quiz Meitantei Neo & Geo - Quiz Daisousa Sen part 2 (NGM-042 ~ NGH-042) (modern set)" )
GAME( 1993, samshom, samsho, neogeo, neogeo, neogeo, ROT0, "SNK", "Samurai Shodown / Samurai Spirits (NGM-045) (modern set)" )
GAME( 1994, tophuntrm, tophuntr, neogeo, neogeo, neogeo, ROT0, "SNK", "Top Hunter - Roddy & Cathy (NGM-046) (modern set)" )
GAME( 1992, androdunm, androdun, neogeo, neogeo, neogeo, ROT0, "Visco", "Andro Dunos (NGM-049 ~ NGH-049) (modern set)" )
GAME( 1992, ncommandm, ncommand, neogeo, neogeo, neogeo, ROT0, "Alpha Denshi Co.", "Ninja Commando (modern set)" )
GAME( 1994, kof94m, kof94, neogeo, neogeo, neogeo, ROT0, "SNK", "The King of Fighters '94 (NGM-055 ~ NGH-055) (modern set)" )
GAME( 1994, aof2m, aof2, neogeo, neogeo, neogeo, ROT0, "SNK", "Art of Fighting 2 / Ryuuko no Ken 2 (NGM-056) (modern set)" )
GAME( 1993, wh2m, wh2, neogeo, neogeo, neogeo, ROT0, "ADK", "World Heroes 2 (ALM-006 ~ ALH-006) (modern set)" )
GAME( 1993, fatfurspm, fatfursp, neogeo, neogeo, neogeo, ROT0, "SNK", "Fatal Fury Special / Garou Densetsu Special (NGM-058 ~ NGH-058, set 1) (modern set)" )
GAME( 1995, savagerem, savagere, neogeo, neogeo, neogeo, ROT0, "SNK", "Savage Reign / Fu'un Mokushiroku - Kakutou Sousei (modern set)" )
GAME( 1994, fightfevm, fightfev, neogeo, neogeo, neogeo, ROT0, "Viccom", "Fight Fever / Wang Jung Wang (set 1) (modern set)" )
GAME( 1994, ssideki2m, ssideki2, neogeo, neogeo, neogeo, ROT0, "SNK", "Super Sidekicks 2 - The World Championship / Tokuten Ou 2 - Real Fight Football (NGM-061 ~ NGH-061) (modern set)" )
GAME( 1993, spinmastm, spinmast, neogeo, neogeo, neogeo, ROT0, "Data East Corporation", "Spin Master / Miracle Adventure (modern set)" )
GAME( 1994, samsho2m, samsho2, neogeo, neogeo, neogeo, ROT0, "SNK", "Samurai Shodown II / Shin Samurai Spirits - Haohmaru Jigokuhen (NGM-063 ~ NGH-063) (modern set)" )
GAME( 1994, wh2jm, wh2j, neogeo, neogeo, neogeo, ROT0, "ADK / SNK", "World Heroes 2 Jet (ADM-007 ~ ADH-007) (modern set)" )
GAME( 1994, wjammersm, wjammers, neogeo, neogeo, neogeo, ROT0, "Data East Corporation", "Windjammers / Flying Power Disc (modern set)" )
GAME( 1994, karnovrm, karnovr, neogeo, neogeo, neogeo, ROT0, "Data East Corporation", "Karnov's Revenge / Fighter's History Dynamite (modern set)" )
GAME( 1994, gururinm, gururin, neogeo, neogeo, neogeo, ROT0, "Face", "Gururin (modern set)" )
GAME( 1994, pspikes2m, pspikes2, neogeo, neogeo, neogeo, ROT0, "Video System Co.", "Power Spikes II (NGM-068) (modern set)" )
GAME( 1995, fatfury3m, fatfury3, neogeo, neogeo, neogeo, ROT0, "SNK", "Fatal Fury 3 - Road to the Final Victory / Garou Densetsu 3 - Haruka-naru Tatakai (NGM-069 ~ NGH-069) (modern set)" )
GAME( 2000, b2b, neogeo, neogeo, neogeo, neogeo, ROT0, "Visco", "Bang Bang Busters (2010 NCI release) (modern set)" )
GAME( 1994, panicbomm, panicbom, neogeo, neogeo, neogeo, ROT0, "Eighting / Hudson Soft", "Panic Bomber (modern set)" )
GAME( 1994, aodkm, aodk, neogeo, neogeo, neogeo, ROT0, "ADK / SNK", "Aggressors of Dark Kombat / Tsuukai GANGAN Koushinkyoku (ADM-008 ~ ADH-008) (modern set)" )
GAME( 1994, sonicwi2m, sonicwi2, neogeo, neogeo, neogeo, ROT0, "Video System Co.", "Aero Fighters 2 / Sonic Wings 2 (modern set)" )
GAME( 1994, zedbladem, zedblade, neogeo, neogeo, neogeo, ROT0, "NMK", "Zed Blade / Operation Ragnarok (modern set)" )
GAME( 1995, galaxyfgm, galaxyfg, neogeo, neogeo, neogeo, ROT0, "Sunsoft", "Galaxy Fight - Universal Warriors (modern set)" )
GAME( 1994, strhoopm, strhoop, neogeo, neogeo, neogeo, ROT0, "Data East Corporation", "Street Hoop / Street Slam / Dunk Dream (DEM-004 ~ DEH-004) (modern set)" )
GAME( 1995, quizkofm, quizkof, neogeo, neogeo, neogeo, ROT0, "Saurus (SNK license)", "Quiz King of Fighters (SAM-080 ~ SAH-080) (modern set)" )
GAME( 1995, ssideki3m, ssideki3, neogeo, neogeo, neogeo, ROT0, "SNK", "Super Sidekicks 3 - The Next Glory / Tokuten Ou 3 - Eikou e no Chousen (modern set)" )
GAME( 1995, doubledrm, doubledr, neogeo, neogeo, neogeo, ROT0, "Technos Japan", "Double Dragon (Neo-Geo) (modern set)" )
GAME( 1995, kof95m, kof95, neogeo, neogeo, neogeo, ROT0, "SNK", "The King of Fighters '95 (NGM-084) (modern set)" )
GAME( 1996, twsoc96, neogeo, neogeo, neogeo, neogeo, ROT0, "Tecmo", "Tecmo World Soccer '96 (modern set)" )
GAME( 1995, samsho3m, samsho3, neogeo, neogeo, neogeo, ROT0, "SNK", "Samurai Shodown III / Samurai Spirits - Zankurou Musouken (NGM-087) (modern set)" )
GAME( 1995, stakwinm, stakwin, neogeo, neogeo, neogeo, ROT0, "Saurus", "Stakes Winner / Stakes Winner - GI Kinzen Seiha e no Michi (modern set)" )
GAME( 1995, pulstarm, pulstar, neogeo, neogeo, neogeo, ROT0, "Aicom", "Pulstar (modern set)" )
GAME( 1995, whpm, whp, neogeo, neogeo, neogeo, ROT0, "ADK / SNK", "World Heroes Perfect (modern set)" )
GAME( 1995, kabukiklm, kabukikl, neogeo, neogeo, neogeo, ROT0, "Hudson Soft", "Far East of Eden - Kabuki Klash / Tengai Makyou - Shin Den (modern set)" )
GAME( 1997, neobombem, neobombe, neogeo, neogeo, neogeo, ROT0, "Hudson Soft", "Neo Bomberman (modern set)" )
GAME( 1995, gowcaizrm, gowcaizr, neogeo, neogeo, neogeo, ROT0, "Technos Japan", "Voltage Fighter - Gowcaizer / Choujin Gakuen Gowcaizer (modern set)" )
GAME( 1995, rbff1m, rbff1, neogeo, neogeo, neogeo, ROT0, "SNK", "Real Bout Fatal Fury / Real Bout Garou Densetsu (NGM-095 ~ NGH-095) (modern set)" )
GAME( 1996, aof3m, aof3, neogeo, neogeo, neogeo, ROT0, "SNK", "Art of Fighting 3 - The Path of the Warrior / Art of Fighting - Ryuuko no Ken Gaiden (modern set)" )
GAME( 1995, sonicwi3m, sonicwi3, neogeo, neogeo, neogeo, ROT0, "Video System Co.", "Aero Fighters 3 / Sonic Wings 3 (modern set)" )
GAME( 1996, turfmastm, turfmast, neogeo, neogeo, neogeo, ROT0, "Nazca", "Neo Turf Masters / Big Tournament Golf (modern set)" )
GAME( 1996, mslugm, mslug, neogeo, neogeo, neogeo, ROT0, "Nazca", "Metal Slug - Super Vehicle-001 (modern set)" )
GAME( 1995, puzzledpm, puzzledp, neogeo, neogeo, neogeo, ROT0, "Visco", "Puzzle De Pon! (modern set)" )
GAME( 1995, moshougi, neogeo, neogeo, neogeo, neogeo, ROT0, "ADK / SNK", "Shougi no Tatsujin - Master of Shougi (modern set)" )
GAME( 1995, marukodqm, marukodq, neogeo, neogeo, neogeo, ROT0, "Takara", "Chibi Maruko-chan: Maruko Deluxe Quiz (modern set)" )
GAME( 1996, neomrdom, neomrdo, neogeo, neogeo, neogeo, ROT0, "Visco", "Neo Mr. Do! (modern set)" )
GAME( 1996, sdodgebm, sdodgeb, neogeo, neogeo, neogeo, ROT0, "Technos Japan", "Super Dodge Ball / Kunio no Nekketsu Toukyuu Densetsu (modern set)" )
GAME( 1995, goalx3m, goalx3, neogeo, neogeo, neogeo, ROT0, "Visco", "Goal! Goal! Goal! (modern set)" )
GAME( 1996, overtopm, overtop, neogeo, neogeo, neogeo, ROT0, "ADK", "Over Top (modern set)" )
GAME( 1996, neodriftm, neodrift, neogeo, neogeo, neogeo, ROT0, "Visco", "Neo Drift Out - New Technology (modern set)" )
GAME( 1996, kof96m, kof96, neogeo, neogeo, neogeo, ROT0, "SNK", "The King of Fighters '96 (NGM-214) (modern set)" )
GAME( 1996, ssideki4m, ssideki4, neogeo, neogeo, neogeo, ROT0, "SNK", "The Ultimate 11 - The SNK Football Championship / Tokuten Ou - Honoo no Libero (modern set)" )
GAME( 1996, kizunam, kizuna, neogeo, neogeo, neogeo, ROT0, "SNK", "Kizuna Encounter - Super Tag Battle / Fu'un Super Tag Battle (modern set)" )
GAME( 1996, ninjamasm, ninjamas, neogeo, neogeo, neogeo, ROT0, "ADK / SNK", "Ninja Master's - Haoh-ninpo-cho (modern set)" )
GAME( 1996, ragnagrdm, ragnagrd, neogeo, neogeo, neogeo, ROT0, "Saurus", "Ragnagard / Shin-Oh-Ken (modern set)" )
GAME( 1996, pgoalm, pgoal, neogeo, neogeo, neogeo, ROT0, "Saurus", "Pleasure Goal / Futsal - 5 on 5 Mini Soccer (NGM-219) (modern set)" )
GAME( 1996, ironclad, neogeo, neogeo, neogeo, neogeo, ROT0, "Saurus", "Choutetsu Brikin'ger / Iron Clad (prototype) (modern set)" )
GAME( 1996, magdrop2m, magdrop2, neogeo, neogeo, neogeo, ROT0, "Data East Corporation", "Magical Drop II (modern set)" )
GAME( 1996, twinsprim, twinspri, neogeo, neogeo, neogeo, ROT0, "ADK / SNK", "Twinkle Star Sprites (modern set)" )
GAME( 1996, wakuwak7m, wakuwak7, neogeo, neogeo, neogeo, ROT0, "Sunsoft", "Waku Waku 7 (modern set)" )
GAME( 1996, stakwin2m, stakwin2, neogeo, neogeo, neogeo, ROT0, "Saurus", "Stakes Winner 2 (modern set)" )
GAME( 1996, ghostlop, neogeo, neogeo, neogeo, neogeo, ROT0, "Data East Corporation", "Ghostlop (prototype) (modern set)" )
GAME( 1996, breakersm, breakers, neogeo, neogeo, neogeo, ROT0, "Visco", "Breakers (modern set)" )
GAME( 1997, miexchngm, miexchng, neogeo, neogeo, neogeo, ROT0, "Face", "Money Puzzle Exchanger / Money Idol Exchanger (modern set)" )
GAME( 1997, magdrop3m, magdrop3, neogeo, neogeo, neogeo, ROT0, "Data East Corporation", "Magical Drop III (modern set)" )
GAME( 1997, puzzldprm, puzzldpr, neogeo, neogeo, neogeo, ROT0, "Visco", "Puzzle De Pon! R! (modern set)" )
GAME( 1997, popbouncm, popbounc, neogeo, neogeo, neogeo, ROT0, "Video System Co.", "Pop 'n Bounce / Gapporin (modern set)" )
GAME( 1998, blazstarm, blazstar, neogeo, neogeo, neogeo, ROT0, "Yumekobo", "Blazing Star (modern set)" )
GAME( 1998, mslug2m, mslug2, neogeo, neogeo, neogeo, ROT0, "SNK", "Metal Slug 2 - Super Vehicle-001/II (NGM-2410 ~ NGH-2410) (modern set)" )
GAME( 1998, neocup98m, neocup98, neogeo, neogeo, neogeo, ROT0, "SNK", "Neo-Geo Cup '98 - The Road to the Victory (modern set)" )
GAME( 1998, breakrevm, breakrev, neogeo, neogeo, neogeo, ROT0, "Visco", "Breakers Revenge (modern set)" )
GAME( 1998, flipshotm, flipshot, neogeo, neogeo, neogeo, ROT0, "Visco", "Flip Shot (modern set)" )
GAME( 1999, pbobbl2nm, pbobbl2n, neogeo, neogeo, neogeo, ROT0, "Taito (SNK license)", "Puzzle Bobble 2 / Bust-A-Move Again (Neo-Geo) (modern set)" )
GAME( 1999, ctomadaym, ctomaday, neogeo, neogeo, neogeo, ROT0, "Visco", "Captain Tomaday (modern set)" )
GAME( 2001, vliner, neogeo, neogeo, neogeo, neogeo, ROT0, "Dyna / BrezzaSoft", "V-Liner (v0.7a) (modern set)" )
GAME( 1996, zintrckb, neogeo, neogeo, neogeo, neogeo, ROT0, "bootleg", "Zintrick / Oshidashi Zentrix (bootleg of CD version) (modern set)" )
GAME( 1995, froman2b, neogeo, neogeo, neogeo, neogeo, ROT0, "bootleg", "Idol Mahjong Final Romance 2 (Neo-Geo, bootleg of CD version) (modern set)" )
GAME( 1996, crswd2bl, neogeo, neogeo, neogeo, neogeo, ROT0, "bootleg (Razoola)", "Crossed Swords 2 (bootleg of CD version) (modern set)" )
GAME( 2000, diggerma, neogeo, neogeo, neogeo, neogeo, ROT0, "Kyle Hodgetts", "Digger Man (prototype) (modern set)" )
GAME( 2005, lasthope, neogeo, neogeo, neogeo, neogeo, ROT0, "NG:DEV.TEAM", "Last Hope (bootleg AES to MVS conversion, no coin support) (modern set)" )
